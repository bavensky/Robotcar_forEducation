#include <LCD5110_Basic.h>    // เรียกใช้งานไลบรารี่จอแสดงผล 5110
#include <avr/pgmspace.h>
// This program requires a Nokia 5110 LCD module.
// correct voltage to the module.
//      SCK  - Pin 10
//      MOSI - Pin 11
//      DC   - Pin 12
//      RST  - Pin 13
//      CS   - Pin 8
//
LCD5110 myGLCD(10,11,12,13,8);
extern uint8_t arduino_logo[];  //  logo arduino
extern uint8_t SmallFont[];
extern uint8_t MediumNumbers[];
extern uint8_t BigNumbers[];

#define SENSOR_1  A2  
#define SENSOR_2  A3
#define SWITCH    A5

int motorA_a = 9;  
int motorA_b = 6; 
int motorB_a = 5;   
int motorB_b = 3;  

unsigned int mode = 0;
int function = 0;
int switch_all = 0; 
char key;

int sensorValue1 = 0;    
int sensorValue2 = 0;  
int rang1 = 0;
int rang2 = 0;
int outputValue = 0;       

void setup() {

  Serial.begin(9600);
  myGLCD.InitLCD();
  
  pinMode(SWITCH,  INPUT);
  pinMode(SENSOR_1,  INPUT);
  pinMode(SENSOR_2,  INPUT);
    
  pinMode(motorA_a, OUTPUT);        
  pinMode(motorA_b, OUTPUT);      
  pinMode(motorB_a, OUTPUT);       
  pinMode(motorB_b, OUTPUT);
  
  myGLCD.drawBitmap(0, 0, arduino_logo, 84, 48);  
// delay(2000);
// myGLCD.clrScr();
}

void loop() {
/************  Drive Motor  ****************************
Motor Right
  motorA_a  =  1  Go Forward
  motorA_b  =  1  Go Reverse
Motor Left  
  motorB_a  =  1  Go Reverse
  motorB_b  =  1  Go Forward
********************************************************/

  read_switch();
  switch(key)  {
    case 'E' :
      mode += 1;
      myGLCD.clrScr();
    break;
  }
  if(mode >= 3)  {
    mode = 0;  
  }
  while(mode == 0)  {
    myGLCD.drawBitmap(0, 0, arduino_logo, 84, 48);  
    read_sensor() ;
    
    read_switch();
    switch(key)  {
    case 'E' :
      mode += 1;
      myGLCD.clrScr();
    break;
    case 'C' :
      mode -= 1;
      myGLCD.clrScr();
    break;
   }
    
  }
    
  while(mode == 1)  {
    read_switch();
    switch(key)  {
    case 'E' :
      mode += 1;
      myGLCD.clrScr();
    break;
    case 'C' :
      mode -= 1;
      myGLCD.clrScr();
    break;
    case 'P' :
      rang1 += 1;
    break;
    case 'M' :
      rang1 -= 1;
    break;
   }
   
    sensorValue1 = analogRead(SENSOR_1);
    sensorValue2 = analogRead(SENSOR_2);
    
    myGLCD.setFont(SmallFont);
    myGLCD.print("Line Follow !", LEFT, 0);
    myGLCD.print("Sensor    ", LEFT, 8);
    myGLCD.print(" Left     ", LEFT, 16);
    myGLCD.print("Set       ", LEFT, 32);
    myGLCD.print(" Rang     ", LEFT, 40);
    myGLCD.setFont(MediumNumbers);
    myGLCD.printNumI(sensorValue1, RIGHT, 8);
    myGLCD.printNumI(rang1, RIGHT, 32);
    myGLCD.printNumI(switch_all, RIGHT, 40);
  }
  
   while(mode == 2)  {
     read_switch();
    switch(key)  {
    case 'E' :
      mode += 1;
      myGLCD.clrScr();
    break;
    case 'C' :
      mode -= 1;
      myGLCD.clrScr();
    break;
    case 'P' :
      rang2 += 1;
    break;
    case 'M' :
      rang2 -= 1;
    break;
   }
   
    sensorValue1 = analogRead(SENSOR_1);
    sensorValue2 = analogRead(SENSOR_2);
    
    myGLCD.setFont(SmallFont);
    myGLCD.print("Line Follow !", LEFT, 0);
    myGLCD.print("Sensor    ", LEFT, 8);
    myGLCD.print(" Right    ", LEFT, 16);
    myGLCD.print("Set       ", LEFT, 32);
    myGLCD.print(" Rang     ", LEFT, 40);
    myGLCD.setFont(MediumNumbers);
    myGLCD.printNumI(sensorValue2, RIGHT, 8);
    myGLCD.printNumI(rang2, RIGHT, 32);
    myGLCD.printNumI(switch_all, RIGHT, 40);
   }
}

void read_switch()  {
  switch_all  =  analogRead(SWITCH);
  if(switch_all > 850)  {
    delay(200);
    key = 'X';
  }
  if(switch_all > 600  &&  switch_all < 800)  {
    delay(200);
    key = 'E';
  }
  if(switch_all > 450  &&  switch_all < 600)  {
    delay(200);
    key = 'C';
  }
  if(switch_all > 200  &&  switch_all < 400)  {
    delay(200);
    key = 'P';
  }
  if(switch_all > 100  &&  switch_all < 300)  {
    delay(200);
    key = 'M';
  }
}

void read_sensor()  {
  sensorValue1 = analogRead(SENSOR_1);
  sensorValue2 = analogRead(SENSOR_2);
  
  if(sensorValue1 < rang1  && sensorValue2 < rang2)  {
    analogWrite(motorA_a,  128);
    analogWrite(motorA_b,  0);
    analogWrite(motorB_a,  0);
    analogWrite(motorB_b,  128);
  }
  
  if(sensorValue1 < rang1  &&  sensorValue2  >  rang2)  {
    analogWrite(motorA_a,  0);
    analogWrite(motorA_b,  0);
    analogWrite(motorB_a,  0);
    analogWrite(motorB_b,  128); 
  }
  
  if(sensorValue1 > rang1  &&  sensorValue2  <  rang2)  {
    delay(200);
    analogWrite(motorA_a,  128);
    analogWrite(motorA_b,  0);
    analogWrite(motorB_a,  0);
    analogWrite(motorB_b,  0); 
  }
  if(sensorValue1 > rang1 && sensorValue2 > rang2)  {
    analogWrite(motorA_a,  1);
    analogWrite(motorA_b,  1);
    analogWrite(motorB_a,  1);
    analogWrite(motorB_b,  1);
  }  
}


uint8_t arduino_logo[] PROGMEM={
0x00, 0x00, 0x00, 0x00, 0x00, 0x00, 0x00, 0x00, 0x80, 0xC0, 0xE0, 0xF0, 0xF8, 0xF8, 0xFC, 0xFC,   // 0x0010 (16) pixels
0xFE, 0xFE, 0x7F, 0x7F, 0x7F, 0x3F, 0x3F, 0x3F, 0x3F, 0x3F, 0x7F, 0x7F, 0x7F, 0xFE, 0xFE, 0xFE,   // 0x0020 (32) pixels
0xFC, 0xFC, 0xF8, 0xF0, 0xF0, 0xE0, 0xC0, 0x80, 0x00, 0x00, 0x00, 0x00, 0x00, 0x80, 0xC0, 0xE0,   // 0x0030 (48) pixels
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0x7F, 0x0E, 0x00, 0x00, 0x00, 0x00, 0x00, 0x00, 
};
